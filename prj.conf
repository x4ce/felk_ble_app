## CMakeLists.txt
```
cmake_minimum_required(VERSION 3.20.0)
find_package(Zephyr REQUIRED HINTS $ENV{ZEPHYR_BASE})

project(felk_ble_app)

target_sources(app PRIVATE src/main.c)

target_sources(app PRIVATE
    src/common.c
    src/remote.c
    src/pwm_f.c
    src/adc_f.c
    src/mtr_api.c
)

zephyr_library_include_directories(library)
```

## prj.conf
```kconfig
# BT Settings
CONFIG_BT=y
CONFIG_BT_PERIPHERAL=y
CONFIG_BT_DEVICE_NAME="Felk_App"

CONFIG_NEWLIB_LIBC=y
CONFIG_FPU=y

CONFIG_NVS=y
CONFIG_PM_PARTITION_SIZE_NVS_STORAGE=0x2000

CONFIG_BOOTLOADER_MCUBOOT=y
CONFIG_NCS_SAMPLE_MCUMGR_BT_OTA_DFU=y

# Increase stack size for the main thread and System Workqueue
CONFIG_SYSTEM_WORKQUEUE_STACK_SIZE=2048
CONFIG_MAIN_STACK_SIZE=2048

CONFIG_LOG=n
CONFIG_CONSOLE=n
CONFIG_PRINTK=n
CONFIG_UART_CONSOLE=n
CONFIG_BOOT_BANNER=n

CONFIG_SYSTEM_WORKQUEUE_STACK_SIZE=1024
```

## src/adc_f.c
```c
#include "adc_f.h"

#define         CH2_ADC_MF           1.5      // Pressure Sensor
#define         CH3_ADC_MF           1        // Battery/ Pressure Sensor
#define         CH1_ADC_MF           8.5      // CR1: 10k/(75k+10k) = 0.117 ~= 1/8.5
#define         CH5_ADC_MF           8.5      // CR2: 10k/(75k+10k) = 0.117 ~= 1/8.5
#define         CH6_ADC_MF           8.5      // Bat: 10k/(75k+10k) = 0.117 ~= 1/8.5   
#define         CH7_ADC_MF           1        // Therm: 10k/(10k+0) = 1

#define         ADC_MEAS_NO         10        // Number of ADC measurements for averaging
#define         ADC_MEAS_INT        2         // Interval between ADC measurements in ms

uint16_t buf;

struct adc_sequence sequence = {
	.buffer = &buf,
	/* buffer size in bytes, not number of samples */
	.buffer_size = sizeof(buf),
    .calibrate = true,
};

static const struct adc_dt_spec adc_ch0 = ADC_DT_SPEC_GET_BY_IDX(DT_PATH(zephyr_user), 0);
static const struct adc_dt_spec adc_ch1 = ADC_DT_SPEC_GET_BY_IDX(DT_PATH(zephyr_user), 1);
static const struct adc_dt_spec adc_ch2 = ADC_DT_SPEC_GET_BY_IDX(DT_PATH(zephyr_user), 2);
static const struct adc_dt_spec adc_ch3 = ADC_DT_SPEC_GET_BY_IDX(DT_PATH(zephyr_user), 3);
static const struct adc_dt_spec adc_ch4 = ADC_DT_SPEC_GET_BY_IDX(DT_PATH(zephyr_user), 4);
static const struct adc_dt_spec adc_ch5 = ADC_DT_SPEC_GET_BY_IDX(DT_PATH(zephyr_user), 5);
static const struct adc_dt_spec adc_ch6 = ADC_DT_SPEC_GET_BY_IDX(DT_PATH(zephyr_user), 6);
static const struct adc_dt_spec adc_ch7 = ADC_DT_SPEC_GET_BY_IDX(DT_PATH(zephyr_user), 7);

void adc_init(void)
{
    int err;

    if (!device_is_ready(adc_ch0.dev))
    {
    printk("ADC controller device %s not ready\n", adc_ch0.dev->name);
    }

    err = adc_channel_setup_dt(&adc_ch0);
    if (err <0)
    {
        printk("Could not setup channel #0 (%d)\n", err);
    }

    if (!device_is_ready(adc_ch1.dev))
    {
    printk("ADC controller device %s not ready\n", adc_ch1.dev->name);
    }

    err = adc_channel_setup_dt(&adc_ch1);
    if (err <0)
    {
        printk("Could not setup channel #0 (%d)\n", err);
    }

    if (!device_is_ready(adc_ch2.dev))
    {
    printk("ADC controller device %s not ready\n", adc_ch2.dev->name);
    }

    err = adc_channel_setup_dt(&adc_ch2);
    if (err <0)
    {
        printk("Could not setup channel #3 (%d)\n", err);
    }

    if (!device_is_ready(adc_ch3.dev))
    {
    printk("ADC controller device %s not ready\n", adc_ch3.dev->name);
    }

    err = adc_channel_setup_dt(&adc_ch3);
    if (err <0)
    {
        printk("Could not setup channel #4 (%d)\n", err);
    }
    
    if (!device_is_ready(adc_ch4.dev))
    {
    printk("ADC controller device %s not ready\n", adc_ch4.dev->name);
    }

    err = adc_channel_setup_dt(&adc_ch4);
    if (err <0)
    {
        printk("Could not setup channel #4 (%d)\n", err);
    }

    if (!device_is_ready(adc_ch5.dev))
    {
    printk("ADC controller device %s not ready\n", adc_ch5.dev->name);
    }

    err = adc_channel_setup_dt(&adc_ch5);
    if (err <0)
    {
        printk("Could not setup channel #5 (%d)\n", err);
    }

    if (!device_is_ready(adc_ch6.dev))
    {
    printk("ADC controller device %s not ready\n", adc_ch6.dev->name);
    }

    err = adc_channel_setup_dt(&adc_ch6);
    if (err <0)
    {
        printk("Could not setup channel #5 (%d)\n", err);
    }

    if (!device_is_ready(adc_ch7.dev))
    {
    printk("ADC controller device %s not ready\n", adc_ch7.dev->name);
    }

    err = adc_channel_setup_dt(&adc_ch7);
    if (err <0)
    {
        printk("Could not setup channel #5 (%d)\n", err);
    }

}

uint16_t read_adc(uint8_t ch)
{
    int err; 
    int32_t val_mv;
    uint8_t i;
    int32_t tmp_buf = 0;

    switch(ch)
    {
        case 0:
            printk("ADC reading of device %s, channel %d: ", 
                adc_ch0.dev->name, adc_ch0.channel_id);
            (void)adc_sequence_init_dt(&adc_ch0, &sequence);
            
            // for (i = 0; i < ADC_MEAS_NO; i++)
            // {
            //     err = adc_read(adc_ch7.dev, &sequence);
            //     k_msleep(ADC_MEAS_INT);
            //     if (err <0)
            //     {
            //         printk("Could not read (%d)\n", err);
            //     } else {
            //         tmp_buf += (int32_t)buf;
            //     }
            // }
            // val_mv = (int32_t) tmp_buf / ADC_MEAS_NO;

            err = adc_read(adc_ch0.dev, &sequence);
            if (err <0)
            {
                printk("Could not read (%d)\n", err);
            } else {
                val_mv = (int32_t)buf;
            }

            printk("%"PRId32"\n", val_mv);
            // err = adc_raw_to_millivolts_dt(&adc_ch7, &val_mv);
        
            // val_mv = (int32_t)(val_mv * CH7_ADC_MF);

            // if (err < 0) {
            //     printk(" (value in mV not available)\n");
            // } else {
            //     printk(" = %"PRId32" mV\n", val_mv);
            // }
            break;
        case 1:
            printk("ADC reading of device %s, channel %d: ", 
                adc_ch1.dev->name, adc_ch1.channel_id);
            (void)adc_sequence_init_dt(&adc_ch1, &sequence);
            // for (i = 0; i < ADC_MEAS_NO; i++)
            // {
            //     err = adc_read(adc_ch4.dev, &sequence);
            //     k_msleep(ADC_MEAS_INT);
            //     if (err <0)
            //     {
            //         printk("Could not read (%d)\n", err);
            //     } else {
            //         tmp_buf += (int32_t)buf;
            //     }
            // }
            // val_mv = (int32_t) tmp_buf / ADC_MEAS_NO;
        
            err = adc_read(adc_ch1.dev, &sequence);
            if (err <0)
            {
                printk("Could not read (%d)\n", err);
            } else {
                val_mv = (int32_t)buf;
            }

            printk("%"PRId32, val_mv);
            err = adc_raw_to_millivolts_dt(&adc_ch1, &val_mv);
        
            val_mv = (int32_t)(val_mv * CH1_ADC_MF);

            if (val_mv > 50000)
            {
                val_mv = 0;
            }

            if (err < 0) {
                printk(" (value in mV not available)\n");
            } else {
                printk(" = %"PRId32" mV\n", val_mv);
            }
            break;
        case 2:
            printk("ADC reading of device %s, channel %d: ", 
                adc_ch2.dev->name, adc_ch2.channel_id);
            (void)adc_sequence_init_dt(&adc_ch2, &sequence);
            
            // for (i = 0; i < ADC_MEAS_NO; i++)
            // {
            //     err = adc_read(adc_ch2.dev, &sequence);
            //     k_msleep(ADC_MEAS_INT);
            //     if (err <0)
            //     {
            //         printk("Could not read (%d)\n", err);
            //     } else {
            //         tmp_buf += (int32_t)buf;
            //     }
            // }

            // val_mv = (int32_t) tmp_buf / ADC_MEAS_NO;
            
            err = adc_read(adc_ch2.dev, &sequence);
            if (err <0)
                {
                    printk("Could not read (%d)\n", err);
                } else {
                    val_mv = (int32_t)((int16_t)buf);
                }
            
            printk("%"PRId32, val_mv);
            err = adc_raw_to_millivolts_dt(&adc_ch2, &val_mv);
            
            //val_mv = (int32_t)(val_mv / CH2_ADC_MF);

            if (err < 0) {
                printk(" (value in mV not available)\n");
            } else {
                printk(" = %"PRId32" mV\n", val_mv);
            }
            break;

        case 3:
            printk("ADC reading of device %s, channel %d: ", 
                adc_ch3.dev->name, adc_ch3.channel_id);
            (void)adc_sequence_init_dt(&adc_ch3, &sequence);
            // for (i = 0; i < ADC_MEAS_NO; i++)
            // {
            //     err = adc_read(adc_ch3.dev, &sequence);
            //     k_msleep(ADC_MEAS_INT);
            //     if (err <0)
            //     {
            //         printk("Could not read (%d)\n", err);
            //     } else {
            //         tmp_buf += (int32_t)buf;
            //     }
            // }
            // val_mv = (int32_t) tmp_buf / ADC_MEAS_NO;

            err = adc_read(adc_ch3.dev, &sequence);
            if (err <0)
            {
                printk("Could not read (%d)\n", err);
            } else {
                val_mv = (int32_t)((int16_t)buf);
            }
        
            printk("%"PRId32, val_mv);
            err = adc_raw_to_millivolts_dt(&adc_ch3, &val_mv);
        
            //val_mv = (int32_t)(val_mv * CH3_ADC_MF);

            if (err < 0) {
                printk(" (value in mV not available)\n");
            } else {
                printk(" = %"PRId32" mV\n", val_mv);
            }
            break;

        case 4:
            printk("ADC reading of device %s, channel %d: ", 
            adc_ch4.dev->name, adc_ch4.channel_id);
            (void)adc_sequence_init_dt(&adc_ch4, &sequence);
            err = adc_read(adc_ch4.dev, &sequence);
            if (err <0)
            {
                printk("Could not read (%d)\n", err);
            } else {
                val_mv = (int32_t)buf;
            }
        
            printk("%"PRId32"\n", val_mv);
            // err = adc_raw_to_millivolts_dt(&adc_ch0, &val_mv);
            
            // if (err < 0) {
            //     printk(" (value in mV not available)\n");
            // } else {
            //     printk(" = %"PRId32" mV\n", val_mv);
            // }
            break;

        case 5:
            printk("ADC reading of device %s, channel %d: ", 
                adc_ch5.dev->name, adc_ch5.channel_id);
            (void)adc_sequence_init_dt(&adc_ch5, &sequence);
            // for (i = 0; i < ADC_MEAS_NO; i++)
            // {
            //     err = adc_read(adc_ch5.dev, &sequence);
            //     k_msleep(ADC_MEAS_INT);
            //     if (err <0)
            //     {
            //         printk("Could not read (%d)\n", err);
            //     } else {
            //         tmp_buf += (int32_t)buf;
            //     }
            // }
            // val_mv = (int32_t) tmp_buf / ADC_MEAS_NO;


            err = adc_read(adc_ch5.dev, &sequence);
            if (err <0)
            {
                printk("Could not read (%d)\n", err);
            } else {
                val_mv = (int32_t)buf;
            }

            printk("%"PRId32, val_mv);
            err = adc_raw_to_millivolts_dt(&adc_ch5, &val_mv);
        
            val_mv = (int32_t)(val_mv * CH5_ADC_MF);

            if (val_mv > 50000)
            {
                val_mv = 0;
            }

            if (err < 0) {
                printk(" (value in mV not available)\n");
            } else {
                printk(" = %"PRId32" mV\n", val_mv);
            }
            break;
        case 6:
            printk("ADC reading of device %s, channel %d: ", 
                adc_ch6.dev->name, adc_ch6.channel_id);
            (void)adc_sequence_init_dt(&adc_ch6, &sequence);
            
            err = adc_read(adc_ch6.dev, &sequence);
            if (err <0)
            {
                printk("Could not read (%d)\n", err);
            } else {
                val_mv = (int32_t)buf;
            }
        
            printk("%"PRId32, val_mv);
            err = adc_raw_to_millivolts_dt(&adc_ch6, &val_mv);
        
            val_mv = (int32_t)(val_mv * CH6_ADC_MF);

            if (err < 0) {
                printk(" (value in mV not available)\n");
            } else {
                printk(" = %"PRId32" mV\n", val_mv);
            }
            break;
        case 7:
            printk("ADC reading of device %s, channel %d: ", 
                adc_ch7.dev->name, adc_ch7.channel_id);
            (void)adc_sequence_init_dt(&adc_ch7, &sequence);
            
            // for (i = 0; i < ADC_MEAS_NO; i++)
            // {
            //     err = adc_read(adc_ch7.dev, &sequence);
            //     k_msleep(ADC_MEAS_INT);
            //     if (err <0)
            //     {
            //         printk("Could not read (%d)\n", err);
            //     } else {
            //         tmp_buf += (int32_t)buf;
            //     }
            // }
            // val_mv = (int32_t) tmp_buf / ADC_MEAS_NO;

            err = adc_read(adc_ch7.dev, &sequence);
            if (err <0)
            {
                printk("Could not read (%d)\n", err);
            } else {
                val_mv = (int32_t)buf;
            }

            printk("%"PRId32"\n", val_mv);
            // err = adc_raw_to_millivolts_dt(&adc_ch7, &val_mv);
        
            // val_mv = (int32_t)(val_mv * CH7_ADC_MF);

            // if (err < 0) {
            //     printk(" (value in mV not available)\n");
            // } else {
            //     printk(" = %"PRId32" mV\n", val_mv);
            // }
            break;
        default:
            printk("Invalid channel\n");
            return;
    }

    return (uint16_t)val_mv;

  
}
```

## src/common.c
```c
#include <zephyr/kernel.h>
#include "common.h"
#include "mtr_api.h"

void uart_init(void);

#define			RECEIVE_TIMEOUT			100
#define			RECEIVE_BUFF_SIZE		4

const struct device *uart = DEVICE_DT_GET(DT_NODELABEL(uart0));

static uint8_t tx_buf[] = {"UART Service initialized!\n\r"};
uint8_t rx_buf[RECEIVE_BUFF_SIZE] = {0};

static void uart_cb(const struct device *dev, struct uart_event *evt, void *user_data)
{
	switch (evt->type)
	{
		case UART_RX_RDY:
			if ((evt->data.rx.len) == 4)
			{
                k_work_submit(&uart_rx_work_item);              
			}
			break;
		case UART_RX_DISABLED:
			uart_rx_enable(dev, rx_buf, sizeof(rx_buf), RECEIVE_TIMEOUT);
			break;

		default:
			break;
	}
}

void uart_init(void)
{
    int err;
	
	if (!device_is_ready(uart))
	{
		printk("Error: %s device is not ready!\r\n", uart->name);
		
	}

	err = uart_callback_set(uart, uart_cb, NULL);
	if (err)
	{
		printk("Error: %s callback not set!\r\n", uart->name);
		
	}

	// err = uart_tx(uart, tx_buf, sizeof(tx_buf),SYS_FOREVER_US);
	// if (err)
	// {
	// 	printk("Error: %s transmission failed!\r\n", uart->name);
		
	// }

	err = uart_rx_enable(uart, rx_buf, sizeof(rx_buf), RECEIVE_TIMEOUT);
	if (err)
	{
		printk("Error: %s reception enabling failed!\r\n", uart->name);
		
	}

}

int uart_tx_byte (uint8_t data)
{
	int err;
	err = uart_tx(uart, &data, sizeof(data),SYS_FOREVER_US);
	if (err)
	{
		printk("Error: %s transmission failed!\r\n", uart->name);
		
	}

	return err;
}
```

## src/mtr_api.c
```c
#include <zephyr/kernel.h>
#include "mtr_api.h"
#include "common.h"

uint8_t mtr_ble_status[4] = {0};
uint8_t mtr_uart_status;

void uart_rx_work_handler(struct k_work *work) {

uint8_t tmp = rx_buf[2];

	switch(tmp)
	{
	case 11:		// Motor Start
		mtr_uart_status = (rx_buf[0] == 1) ? (mtr_uart_status | 0x01) : (mtr_uart_status & 0xFE);
		break;
	case 12:		// Motor Stop
        mtr_uart_status = (rx_buf[0] == 1) ? (mtr_uart_status | 0x02) : (mtr_uart_status & 0xFD);
		break;
	case 13:		// Fault Ack
        mtr_uart_status = (rx_buf[0] == 1) ? (mtr_uart_status | 0x04) : (mtr_uart_status & 0xFB);
		break;
	case 14:		// Ping
        mtr_ble_status[3] = (rx_buf[0] == 1) ? (mtr_ble_status[3] | 0x80) : (mtr_uart_status & 0x7F);
		break;
	case 15:		// Motor Run Status
		mtr_ble_status[1] = (mtr_ble_status[1] & 0x07) | ((rx_buf[0] & 0x1F) << 3);
		break;
	case 16:		// Fault type
		mtr_ble_status[0] = rx_buf[0];
		mtr_ble_status[1] = (mtr_ble_status[1] & 0xF8) | rx_buf[1];
		break;
	case 17:		// Motor Speed (RPM)
        mtr_ble_status[2] = rx_buf[0];
		mtr_ble_status[3] = (mtr_ble_status[3] & 0xC0) | rx_buf[1];
		break;
	default:
		__NOP();
		break;
	}

}

K_WORK_DEFINE(uart_rx_work_item, uart_rx_work_handler);

int err;

int bldc_start(void)
{
	int tmp = 11;
    err = uart_tx_byte(tmp);
	if (err)
	{
		printk("Error: BLDC Start UART TX Failed!\r\n");
	}
	return err;
}

int bldc_stop(void)
{
	int tmp = 12;
    err = uart_tx_byte(tmp);
	if (err)
	{
		printk("Error: BLDC Stop UART TX Failed!\r\n");
	}
	return err;
}

int bldc_send_ack(void)
{
	int tmp = 13;
    err = uart_tx_byte(tmp);
	if (err)
	{
		printk("Error: BLDC ACK UART TX Failed!\r\n");
	}
	return err;
}

int bldc_ping(void)
{
	int tmp = 14;
    err = uart_tx_byte(tmp);
	if (err)
	{
		printk("Error: BLDC Ping UART TX Failed!\r\n");
	}
	return err;
}

int bldc_get_run_stat(void)
{
	int tmp = 15;
    err = uart_tx_byte(tmp);
	if (err)
	{
		printk("Error: BLDC Run UART TX Failed!\r\n");
	}
	return err;
}

int bldc_get_fault(void)
{
	int tmp = 16;
    err = uart_tx_byte(tmp);
	if (err)
	{
		printk("Error: BLDC Fault UART TX Failed!\r\n");
	}
	return err;
}

int bldc_get_RPM(void)
{
	int tmp = 17;
    err = uart_tx_byte(tmp);
	if (err)
	{
		printk("Error: BLDC RPM UART TX Failed!\r\n");
	}
	return err;
}

int bldc_process_status(uint8_t num)
{
	int err;
	uint8_t tmp;
	switch (tmp)
	{
		case 14:
			tmp = num;	// Ping
			break;
		case 15:
			tmp = num;	// Run Stat
			break;
		case 16:
			tmp = num;	// Fault type
			break;
		case 17:
			tmp = num;	// Speed (RPM)
			break;
		default:
			__NOP();
			break;
	}

	err = uart_tx_byte(tmp);
	if (err)
	{
		printk("Error: BLDC Status TX Failed!\r\n");
	}
	return err;

}
```

## src/pwm_f.c
```c
#include "pwm_f.h"

uint8_t pwm_ch1_dc;

static const struct pwm_dt_spec pwm_sol3 = PWM_DT_SPEC_GET(DT_NODELABEL(pwm_sol3));
static const struct pwm_dt_spec pwm_buzz = PWM_DT_SPEC_GET(DT_NODELABEL(pwm_buzz));

int pwms_init(void)
{
    int ret;
    printk("Initializing PWM!\n");
    if (!device_is_ready(pwm_sol3.dev)) {
        printk("Error: PWM device %s is not ready!\n", pwm_sol3.dev->name);
        return 31;
    }
    
    if (!device_is_ready(pwm_buzz.dev)) {
        printk("Error: PWM device %s is not ready!\n", pwm_buzz.dev->name);
        return 32;
    }
    
    ret = pwm_set_pulse_dt(&pwm_sol3, 0);
    if (ret < 0) {
        printk("Error %d: failed to set pulse width.\n", ret);
        return 33;
    }

    ret = pwm_set_pulse_dt(&pwm_buzz, 0);
    if (ret < 0) {
        printk("Error %d: failed to set pulse width.\n", ret);
        return 34;
    }

    return 0;

}

int pwm_set_dc(uint8_t ch, uint8_t duty)
{
    if (duty <0 || duty > 100)
    {
        printk("Error: Invalid duty cycle!\n");
        return 35;
    }

    if (ch < 1 || ch > 2)
    {
        printk("Error: Invalid channel!\n");
        return 36;
    }

    int ret;
    uint32_t pulse_width;

    if (ch == 1)
    {
        float tmp = (duty/100.0) * pwm_sol3.period;
        pulse_width = (uint32_t) tmp;
        ret = pwm_set_pulse_dt(&pwm_sol3, pulse_width);
        if (ret != 0)
        {
            printk("Error: Failed to set pulse width!\n");
            return 37;
        }
        pwm_ch1_dc = duty;
    }
    else if (ch == 2)
    {
        float tmp = (duty/100.0) * pwm_buzz.period;
        pulse_width = (uint32_t) tmp;
        ret = pwm_set_pulse_dt(&pwm_buzz, pulse_width);
        if (ret != 0)
        {
            printk("Error: Failed to set pulse width!\n");
            return 38;
        }
    }
    else
    {
        return -1;
    }

    return 0;
}
```

## src/remote.c
```c
#include "remote.h"
#include "common.h"
#include "mtr_api.h"

#define         ADC_NO_CH               8

extern uint16_t adc_val;
extern uint16_t press_diff;

static uint16_t bt_read_data[3];
static uint16_t bt_read_data2[4];
static uint8_t bt_read_data3[4];
extern uint16_t adc_data[ADC_NO_CH];
static uint16_t bt_read_status;

struct bt_conn *my_conn = NULL;

static struct felk_ble_cb ble_cb;

static bool indicate_enabled;
static bool notify_mysensor_enabled;
static struct bt_gatt_indicate_params ind_params;

typedef struct adv_mfg_data {
	uint16_t company_code;	    /* Company Identifier Code. */
	uint16_t adc_value;      /* Number of times Button 1 is pressed*/
} adv_mfg_data_type;

/* Declare and set manufacturing data
 first byte is manufacturing company ID & second byte is the data
 which gets updated in advertising data */
static adv_mfg_data_type adv_mfg_data = {COMPANY_ID_CODE,0x00};

// Scan response data byte wirh URI byte
static unsigned char url_data[] ={0x17,'/','/','a','c','a','d','e','m','y','.',
                                 'n','o','r','d','i','c','s','e','m','i','.',
                                 'c','o','m'};
/*
// Declaring and setting adv parameters
static struct bt_le_adv_param *adv_param =
	BT_LE_ADV_PARAM(BT_LE_ADV_OPT_NONE,
	800,
	801,
	NULL);
*/

// Declaring and setting adv parameters
static struct bt_le_adv_param *adv_param = BT_LE_ADV_PARAM((BT_LE_ADV_OPT_CONNECTABLE|BT_LE_ADV_OPT_USE_IDENTITY), 
                BT_GAP_ADV_FAST_INT_MIN_1, /*Min Advertising Interval 500ms (800*0.625ms) */
                BT_GAP_ADV_FAST_INT_MAX_1, /*Max Advertising Interval 500.625ms (801*0.625ms)*/
                NULL); /* Set to NULL for undirected advertising*/

// Advertising data declaration and setting
// static const struct bt_data ad[] = {
// 	/* STEP 4.1.2 - Set the advertising flags */
//     /* non-connectable */
//     BT_DATA_BYTES(BT_DATA_FLAGS, BT_LE_AD_NO_BREDR),
//     /* STEP 4.1.3 - Set the advertising packet data  */
//     BT_DATA(BT_DATA_NAME_COMPLETE, DEVICE_NAME, DEVICE_NAME_LEN),
//     BT_DATA(BT_DATA_MANUFACTURER_DATA,(unsigned char *)&adv_mfg_data, sizeof(adv_mfg_data)),
// };

// Advertising data declaration and setting
static const struct bt_data ad[] = {
	/* STEP 4.1.2 - Set the advertising flags */
    //BT_DATA_BYTES(BT_DATA_FLAGS, BT_LE_AD_NO_BREDR),
    BT_DATA_BYTES(BT_DATA_FLAGS, (BT_LE_AD_GENERAL | BT_LE_AD_NO_BREDR)),
	/* STEP 4.1.3 - Set the advertising packet data  */
    BT_DATA(BT_DATA_NAME_COMPLETE, DEVICE_NAME, DEVICE_NAME_LEN),
    BT_DATA(BT_DATA_MANUFACTURER_DATA,(unsigned char *)&adv_mfg_data, sizeof(adv_mfg_data)),
};


// Scan response data declaration and setting
// static const struct bt_data sd[] = {
//         /* 4.2.3 Include the URL data in the scan response packet*/
//     BT_DATA(BT_DATA_URI, url_data,sizeof(url_data)),
// };

// Scan response data declaration and setting
static const struct bt_data sd[] = {
        /* 4.2.3 Include the URL data in the scan response packet*/
    BT_DATA_BYTES(BT_DATA_UUID128_ALL, BT_UUID_128_ENCODE(0x00001523, 0x1212, 0xefde, 0x1523, 0x785feabcd123)),
    //BT_DATA(BT_DATA_URI, url_data,sizeof(url_data)),
};

void on_connected(struct bt_conn *conn, uint8_t err)
{
    if (err) {
		printk("Connection error %d\n", err);
        return err;
    }
	printk("BLE Connected\n");
    my_conn = bt_conn_ref(conn);
}

void on_disconnected(struct bt_conn *conn, uint8_t reason)
{
	printk("BLE Disconnected. Reason %d\n", reason);
    bt_conn_unref(my_conn);

}

struct bt_conn_cb connection_callbacks = {
    .connected              = on_connected,
    .disconnected           = on_disconnected,
};

static ssize_t read_value(struct bt_conn *conn,
			  const struct bt_gatt_attr *attr,
			  void *buf,
			  uint16_t len,
			  uint16_t offset)
{
	//get a pointer to bt_read_data which is passed in the BT_GATT_CHARACTERISTIC() and stored in attr->user_data
	const uint64_t *value = attr->user_data;

	printk("Attribute read, handle: %u, conn: %p \n", attr->handle, (void *)conn);

    if (ble_cb.data_cb) {
		// Call the application callback function to update the get the current value of the button
		//ble_cb.data_cb();//read_adc();
		bt_read_data[0] = adc_data[6]; // VBat
		bt_read_data[1] = adc_data[5]; // CR2
		bt_read_data[2] = adc_data[1]; // CR1
		return bt_gatt_attr_read(conn, attr, buf, len, offset, value,
					 sizeof(*value));
	}

	return 0;
}

static ssize_t read_value2(struct bt_conn *conn,
				const struct bt_gatt_attr *attr,
				void *buf,
				uint16_t len,
				uint16_t offset)
{
	//get a pointer to bt_read_data which is passed in the BT_GATT_CHARACTERISTIC() and stored in attr->user_data
	const uint64_t *value = attr->user_data;

	printk("Attribute read, handle: %u, conn: %p \n", attr->handle, (void *)conn);

	if (ble_cb.data_cb) {
	// Call the application callback function to update the get the current value of the button
	
	bt_read_data2[0] = press_diff; //adc_data[2]; // Pressure +ve
	bt_read_data2[1] = adc_data[7]; // Temp Pump
	bt_read_data2[2] = adc_data[0]; // Temp PSU
	bt_read_data2[3] = adc_data[3]; // Pressure -ve
	
	return bt_gatt_attr_read(conn, attr, buf, len, offset, value,
			sizeof(*value));
	}

	return 0;
}


static ssize_t read_value3(struct bt_conn *conn,
				const struct bt_gatt_attr *attr,
				void *buf,
				uint16_t len,
				uint16_t offset)
{
	//get a pointer to bt_read_data which is passed in the BT_GATT_CHARACTERISTIC() and stored in attr->user_data
	const uint32_t *value = attr->user_data;

	printk("Attribute read, handle: %u, conn: %p \n", attr->handle, (void *)conn);

	if (ble_cb.data_cb) {
	// Call the application callback function to update the get the current value of the button
	//ble_cb.data_cb();//read_adc();
	bt_read_data3[0] = mtr_ble_status[0];
	bt_read_data3[1] = mtr_ble_status[1];
	bt_read_data3[2] = mtr_ble_status[2];
	bt_read_data3[3] = mtr_ble_status[3];
	
	return bt_gatt_attr_read(conn, attr, buf, len, offset, value,
			sizeof(*value));
	}

	return 0;
}

static ssize_t cmd_value2(struct bt_conn *conn,
			 const struct bt_gatt_attr *attr,
			 const void *buf,
			 uint16_t len, uint16_t offset, uint8_t flags)
{
	printk("Attribute write, handle: %u, conn: %p \n", attr->handle, (void *)conn);

	if (len != 1U) {
		printk("Write cmd: Incorrect data length\n");
		return BT_GATT_ERR(BT_ATT_ERR_INVALID_ATTRIBUTE_LEN);
	}

	if (offset != 0) {
		printk("Write cmd: Incorrect data offset\n");
		return BT_GATT_ERR(BT_ATT_ERR_INVALID_OFFSET);
	}

	if (ble_cb.bldc_rx_cb) {
		//Read the received value 
		uint8_t val = *((uint8_t *)buf);

		if (val || (val == 0)) {
			//Call the application callback function to execute cmd
			ble_cb.bldc_rx_cb(val);
		} else {
			printk("Write led: Incorrect value\n");
			return BT_GATT_ERR(BT_ATT_ERR_VALUE_NOT_ALLOWED);
		}
	}

	return len;
}


static ssize_t cmd_value(struct bt_conn *conn,
			 const struct bt_gatt_attr *attr,
			 const void *buf,
			 uint16_t len, uint16_t offset, uint8_t flags)
{
	printk("Attribute write, handle: %u, conn: %p \n", attr->handle, (void *)conn);

	if (len != 1U) {
		printk("Write cmd: Incorrect data length\n");
		return BT_GATT_ERR(BT_ATT_ERR_INVALID_ATTRIBUTE_LEN);
	}

	if (offset != 0) {
		printk("Write cmd: Incorrect data offset\n");
		return BT_GATT_ERR(BT_ATT_ERR_INVALID_OFFSET);
	}

	if (ble_cb.cmd_cb) {
		//Read the received value 
		uint8_t val = *((uint8_t *)buf);

		if (val || (val == 0)) {
			//Call the application callback function to execute cmd
			ble_cb.cmd_cb(val);
		} else {
			printk("Write led: Incorrect value\n");
			return BT_GATT_ERR(BT_ATT_ERR_VALUE_NOT_ALLOWED);
		}
	}

	return len;
}

static ssize_t cr_value(struct bt_conn *conn,
			 const struct bt_gatt_attr *attr,
			 const void *buf,
			 uint16_t len, uint16_t offset, uint8_t flags)
{
	printk("Attribute write, handle: %u, conn: %p \n", attr->handle, (void *)conn);

	if (len != 2U) {
		printk("Write cmd: Incorrect data length\n");
		return BT_GATT_ERR(BT_ATT_ERR_INVALID_ATTRIBUTE_LEN);
	}

	if (offset != 0) {
		printk("Write cmd: Incorrect data offset\n");
		return BT_GATT_ERR(BT_ATT_ERR_INVALID_OFFSET);
	}

	if (ble_cb.cr_cb) {
		//Read the received value 
		uint16_t val = *((uint16_t *)buf);

		if (val || (val == 0)) {
			//Call the application callback function to execute cmd
			ble_cb.cr_cb(val);
		} else {
			printk("Write led: Incorrect value\n");
			return BT_GATT_ERR(BT_ATT_ERR_VALUE_NOT_ALLOWED);
		}
	}

	return len;
}

static ssize_t read_status(struct bt_conn *conn,
			  const struct bt_gatt_attr *attr,
			  void *buf,
			  uint16_t len,
			  uint16_t offset)
{
	//get a pointer to bt_read_data which is passed in the BT_GATT_CHARACTERISTIC() and stored in attr->user_data
	const uint16_t *value = attr->user_data;

	printk("Attribute read, handle: %u, conn: %p \n", attr->handle, (void *)conn);

    if (ble_cb.status_cb) {
		// Call the application callback function to update the get the current value of the button
		bt_read_status = ble_cb.status_cb();
		return bt_gatt_attr_read(conn, attr, buf, len, offset, value,
					 sizeof(*value));
	}

	return 0;
}

static void felk_ccc_sensor_cfg_changed(const struct bt_gatt_attr *attr,
				  uint16_t value)
{
	notify_mysensor_enabled = (value == BT_GATT_CCC_NOTIFY);
}

static void read_ccc_cfg_changed(const struct bt_gatt_attr *attr,
				  uint16_t value)
{
	indicate_enabled = (value == BT_GATT_CCC_INDICATE);
}

static void indicate_cb(struct bt_conn *conn, struct bt_gatt_indicate_params *params, uint8_t err)
{
	printk("Indication %s\n", err != 0U ? "fail" : "success");
}

/* A function to register application callbacks for the LED and Button characteristics  */
int felk_ble_init(struct felk_ble_cb *callbacks)
{
	if (callbacks) {
		ble_cb.cmd_cb = callbacks->cmd_cb;
		ble_cb.cr_cb = callbacks->cr_cb;
		ble_cb.data_cb = callbacks->data_cb;
		ble_cb.status_cb = callbacks->status_cb;
		ble_cb.bldc_rx_cb = callbacks->bldc_rx_cb;
		ble_cb.bldc_data_cb = callbacks->bldc_data_cb;
	}

	return 0;
}

int bluetooth_init(void)
{
    int err;

    bt_addr_le_t addr;
    err = bt_addr_le_from_str("FF:EE:DD:CC:BB:AA", "random", &addr);
    if (err) {
		printk("Error: Invalid BT address (err %d)\n", err);
        return err;
    }

    err = bt_id_create(&addr, NULL);
    if (err < 0) {
		printk("Error: Creating new ID failed (err %d)\n", err);
        return err;
    }

    err = bt_enable(NULL);
    if (err) {
		printk("Error: Enabling BT!\r\n");
        return err;
    }
    
    err = bt_le_adv_start(adv_param, ad, ARRAY_SIZE(ad), sd, ARRAY_SIZE(sd));
    if (err) {
		printk("Error: Starting BLE advertisement!\r\n");
        return err;
    }

    bt_conn_cb_register(&connection_callbacks);

    return 0;
}

void bt_update_ad(void)
{
    //adv_mfg_data.number_press += 1;
    adv_mfg_data.adc_value = 0xf0f0;//adc_val;
    bt_le_adv_update_data(ad, ARRAY_SIZE(ad), sd, ARRAY_SIZE(sd));
}

BT_GATT_SERVICE_DEFINE(felk_ble_svc,
BT_GATT_PRIMARY_SERVICE(BT_UUID_FELK),
/* Characteristic for reading ADC value */
	BT_GATT_CHARACTERISTIC(BT_UUID_FELK_TX,
			       BT_GATT_CHRC_READ | BT_GATT_CHRC_INDICATE,
			       BT_GATT_PERM_READ, read_value, NULL,
			       &bt_read_data),
/* Client Characteristic Configurator Declaration */

	BT_GATT_CCC(read_ccc_cfg_changed,
					BT_GATT_PERM_READ | BT_GATT_PERM_WRITE),
/* Characteristic for command reception */
	BT_GATT_CHARACTERISTIC(BT_UUID_FELK_RX,
			       BT_GATT_CHRC_WRITE,
			       BT_GATT_PERM_WRITE,
			       NULL, cmd_value, NULL),

/* Characteristic for reading ADC value */
	BT_GATT_CHARACTERISTIC(BT_UUID_FELK_ST,
					BT_GATT_CHRC_READ | BT_GATT_CHRC_INDICATE,
					BT_GATT_PERM_READ, read_status, NULL,
					&bt_read_status),
/* Client Characteristic Configurator Declaration */

	BT_GATT_CCC(read_ccc_cfg_changed,
					 BT_GATT_PERM_READ | BT_GATT_PERM_WRITE),

/* Characteristic for reading sensor value */
	BT_GATT_CHARACTERISTIC(BT_UUID_FELK_SENSOR,
			       BT_GATT_CHRC_NOTIFY,
			       BT_GATT_PERM_NONE, NULL, NULL,
			       NULL),

	BT_GATT_CCC(felk_ccc_sensor_cfg_changed,
		    BT_GATT_PERM_READ | BT_GATT_PERM_WRITE),
				   
/* Characteristic for reading sensor value */
	BT_GATT_CHARACTERISTIC(BT_UUID_FELK_SENSORS,
					BT_GATT_CHRC_READ | BT_GATT_CHRC_INDICATE,
					BT_GATT_PERM_READ, read_value2, NULL,
					&bt_read_data2),

	BT_GATT_CCC(read_ccc_cfg_changed,
			BT_GATT_PERM_READ | BT_GATT_PERM_WRITE),

	/* Characteristic for CR reception */
	BT_GATT_CHARACTERISTIC(BT_UUID_FELK_CR,
			       BT_GATT_CHRC_WRITE,
			       BT_GATT_PERM_WRITE,
			       NULL, cr_value, NULL),
/* Characteristic for reading BLDC Data */
	BT_GATT_CHARACTERISTIC(BT_UUID_FELK_BLDC_TX,
			       BT_GATT_CHRC_READ | BT_GATT_CHRC_INDICATE,
			       BT_GATT_PERM_READ, read_value3, NULL,
			       &bt_read_data3),
/* Client Characteristic Configurator Declaration */

	BT_GATT_CCC(read_ccc_cfg_changed,
					BT_GATT_PERM_READ | BT_GATT_PERM_WRITE),
/* Characteristic for BLDC command reception */
	BT_GATT_CHARACTERISTIC(BT_UUID_FELK_BLDC_RX,
			       BT_GATT_CHRC_WRITE,
			       BT_GATT_PERM_WRITE,
			       NULL, cmd_value2, NULL),
);

int read_val_indicate(uint16_t val)
{
	if (!indicate_enabled) {
		return -EACCES;
	}

	ind_params.attr = &felk_ble_svc.attrs[2];
	ind_params.func = indicate_cb;
	ind_params.destroy = NULL;
	ind_params.data = &val;
	ind_params.len = sizeof(val);
	return bt_gatt_indicate(NULL, &ind_params);

}

int felk_send_sensor_notify(uint16_t sensor_value)
{
	if (!notify_mysensor_enabled) {
		return -EACCES;
	}

	return bt_gatt_notify(NULL, &felk_ble_svc.attrs[7], 
			      &sensor_value,
			      sizeof(sensor_value));
}
```
